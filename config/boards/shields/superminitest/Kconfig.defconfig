## config/boards/shields/superminitest/Kconfig.defconfig
```kconfig
if SHIELD_SUPERMINITEST

config ZMK_KEYBOARD_NAME
    default "SuperminiTest"

config ZMK_SPLIT_ROLE_CENTRAL
    default y

endif
```

## config/boards/shields/superminitest/Kconfig.shield
```kconfig
# Copyright (c) 2020 Pete Johanson
# SPDX-License-Identifier: MIT

config SHIELD_SUPERMINITEST
    def_bool $(shields_list_contains,supeminitest)
```
